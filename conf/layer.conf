## conf/layer.conf
```bitbake
# We have a conf and classes directory, add to BBPATH
BBPATH .= ":${LAYERDIR}"

# We have recipes-* directories, add to BBFILES
BBFILES += "${LAYERDIR}/recipes-*/*/*.bb \
            ${LAYERDIR}/recipes-*/*/*.bbappend"

BBFILE_COLLECTIONS += "meta-licscan"
BBFILE_PATTERN_meta-licscan = "^${LAYERDIR}/"
BBFILE_PRIORITY_meta-licscan = "6"

LAYERDEPENDS_meta-licscan = "core"
LAYERSERIES_COMPAT_meta-licscan = "\
    thud \
    warrior \
    zeus \
    dunfell \
    gatesgarth \
"

INHERIT += "licscan"
```
